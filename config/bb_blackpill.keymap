/*
 * Copyright (c) 2022 The ZMK Contributors
 *
 * SPDX-License-Identifier: MIT
 */

#include <behaviors.dtsi>
#include <dt-bindings/zmk/keys.h>
#include <behaviors/mouse_setting.dtsi>
#include "includes/mouse.dtsi"

//init

/ {
    keymap {
        compatible = "zmk,keymap";

        default_layer {
            bindings = <
                // Blackpill onboard user key button
                &mms MS_TP_SENSITIVITY_INCR

                // Switches connected directly to gpio pins
                &kp B
                &kp C
            >;
        };
    };
};
